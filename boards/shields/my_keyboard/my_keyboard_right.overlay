// overlay to my_keyboard.conf
&default_transform { // Offset of 3 because the left side has 3 columns
    col-offset = <3>;
};

/ {
    split: split {
        compatible = "zmk,split-i2c";
        // 右手側をペリフェラル（スレーブ）に設定
        role = "peripheral";
    };
}
